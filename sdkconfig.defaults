## sdkconfig.defaults.esp32p4
```kconfig
# ESP32-P4 Specific Configuration
# Note: ESP32-P4 uses ESP32-C6 as wireless coprocessor via ESP-Hosted
# Hardware: 32MB internal PSRAM, 32MB external NOR Flash

# Flash configuration (32MB @ 80MHz QIO)
CONFIG_ESPTOOLPY_FLASHSIZE_32MB=y
CONFIG_ESPTOOLPY_FLASHSIZE="32MB"
CONFIG_ESPTOOLPY_FLASHFREQ_80M=y
CONFIG_ESPTOOLPY_FLASHMODE_QIO=y

# HTTP Server WebSocket support
CONFIG_HTTPD_WS_SUPPORT=y
CONFIG_HTTPD_MAX_REQ_HDR_LEN=2048
CONFIG_HTTPD_MAX_URI_LEN=1024

# mDNS
CONFIG_MDNS_MAX_SERVICES=10

# LittleFS
CONFIG_LITTLEFS_MAX_PARTITIONS=3

#
# ESP System Settings
#
CONFIG_XTAL_FREQ_40=y
CONFIG_XTAL_FREQ=40
CONFIG_ESP_DEFAULT_CPU_FREQ_MHZ_360=y
CONFIG_ESP_DEFAULT_CPU_FREQ_MHZ=360

# Main task stack
CONFIG_ESP_MAIN_TASK_STACK_SIZE=8192
CONFIG_PTHREAD_TASK_STACK_SIZE_DEFAULT=4096

# PSRAM for P4 (32MB internal PSRAM @ 200MHz)
CONFIG_SPIRAM=y
CONFIG_SPIRAM_MODE_HEX=y
CONFIG_SPIRAM_SPEED_200M=y
CONFIG_SPIRAM_MALLOC_ALWAYSINTERNAL=4096
CONFIG_SPIRAM_MALLOC_RESERVE_INTERNAL=65536
CONFIG_SPIRAM_TRY_ALLOCATE_WIFI_LWIP=y
CONFIG_SPIRAM_ALLOW_STACK_EXTERNAL_MEMORY=y

# DSP library
CONFIG_DSP_MAX_FFT_SIZE_4096=y

# Compiler
CONFIG_COMPILER_OPTIMIZATION_PERF=y

# Partition table
CONFIG_PARTITION_TABLE_CUSTOM=y

# CONFIG_FATFS_LFN_NONE is not set
# CONFIG_FATFS_LFN_HEAP is not set
CONFIG_FATFS_LFN_STACK=y

#
# ESP-Hosted Configuration (WiFi/BLE via ESP32-C6 coprocessor)
#
CONFIG_ESP_WIFI_REMOTE_ENABLED=y
CONFIG_SLAVE_IDF_TARGET_ESP32C6=y
CONFIG_ESP_HOSTED_ENABLED=y

# ESP-Hosted SPI interface to C6
CONFIG_ESP_SDIO_HOST_INTERFACE=n
CONFIG_ESP_SPI_HOST_INTERFACE=y
CONFIG_ESP_SPI_CONTROLLER=SPI2_HOST
CONFIG_ESP_SPI_CLK_FREQ=40000000
CONFIG_ESP_SPI_TX_Q_SIZE=20
CONFIG_ESP_SPI_RX_Q_SIZE=20

# GPIO pins for SPI connection to C6 (adjust based on your board)
CONFIG_ESP_SPI_GPIO_HANDSHAKE=2
CONFIG_ESP_SPI_GPIO_DATA_READY=3
CONFIG_ESP_SPI_GPIO_CS=10
CONFIG_ESP_SPI_GPIO_CLK=11
CONFIG_ESP_SPI_GPIO_MOSI=12
CONFIG_ESP_SPI_GPIO_MISO=13

# C6 reset/boot pins
CONFIG_ESP_GPIO_SLAVE_RESET=54
CONFIG_ESP_GPIO_SLAVE_BOOT=55

# WiFi settings (via hosted C6)
CONFIG_ESP_WIFI_STATIC_RX_BUFFER_NUM=4
CONFIG_ESP_WIFI_DYNAMIC_RX_BUFFER_NUM=16
CONFIG_ESP_WIFI_DYNAMIC_TX_BUFFER_NUM=16
CONFIG_ESP_WIFI_AMPDU_TX_ENABLED=y
CONFIG_ESP_WIFI_TX_BA_WIN=6
CONFIG_ESP_WIFI_AMPDU_RX_ENABLED=y
CONFIG_ESP_WIFI_RX_BA_WIN=6

#
# Wi-Fi Provisioning Manager
#
CONFIG_WIFI_PROV_SCAN_MAX_ENTRIES=16
CONFIG_WIFI_PROV_AUTOSTOP_TIMEOUT=30
CONFIG_WIFI_PROV_DISCONNECT_AFTER_PROV=y
CONFIG_WIFI_PROV_STA_ALL_CHANNEL_SCAN=y

# P4-specific: Enable USB support
CONFIG_TINYUSB_CDC_ENABLED=y

# MIPI-CSI Camera
CONFIG_MIPI_CSI_ISR_IRAM_SAFE=n
CONFIG_CAM_CTLR_MIPI_CSI_ISR_CACHE_SAFE=n

# OV5647 Camera Sensor
CONFIG_CAMERA_OV5647=y
CONFIG_CAMERA_OV5647_AUTO_DETECT_MIPI_INTERFACE_SENSOR=y
CONFIG_CAMERA_OV5647_MIPI_RAW8_800X640_50FPS=y
CONFIG_CAMERA_OV5647_CSI_LINESYNC_ENABLE=y

# JPEG Codec
CONFIG_JPEG_ENABLE_DEBUG_LOG=n
```
